## Kconfig
```kconfig
DT_COMPAT_ZMK_KSCAN_FW16 := zmk,kscan-fw16

#config ZMK_KSCAN_DIRECT_POLLING
#    bool

menu "ZMK FW16"

config ZMK_KSCAN_FW16_DRIVER
    bool
    default $(dt_compat_enabled,$(DT_COMPAT_ZMK_KSCAN_FW16))
    select ADC
    select GPIO
    select ZMK_DEBOUNCE

endmenu
```

## boards/arm/fw16/Kconfig.defconfig
```kconfig
if BOARD_FW16

config BOARD
	default "fw16"

config RP2_FLASH_W25Q080
	default y

config USB_SELF_POWERED
	default n

endif # BOARD_FW16
```

## boards/shields/fw16_ansi/Kconfig.defconfig
```kconfig
if ZMK_SHIELD_FW16_ANSI

config ZMK_KEYBOARD_NAME
    default "Framework 16 ANSI"

endif
```

## dts/bindings/kscan/zmk,kscan-fw16.yaml
```yaml
description: ZMK kscan driver for Framework 16 (RP2040 ADC + 3-bit mux)
compatible: "zmk,kscan-fw16"
include: [kscan.yaml]
properties:
  col-gpios:
    type: phandle-array
    required: true
  mux-gpios:
    type: phandle-array
    required: true
  mux-enable-gpios:
    type: phandle-array
    required: true
  io-channels:
    type: phandle-array
    required: true
  adc-gpios:
    type: phandle-array
    required: false
    description: Optional GPIO spec for the ADC pad to enable internal pull-up (e.g. <&gpio0 28 GPIO_PULL_UP>)
  columns:
    type: int
    required: true
  rows:
    type: int
    required: true
  debounce-press-ms:
    type: int
  debounce-release-ms:
    type: int
  debounce-scan-period-ms:
    type: int
    default: 1
  poll-period-ms:
    type: int
    default: 15
```
